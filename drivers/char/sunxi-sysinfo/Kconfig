## drivers/char/sunxi-sysinfo/Kconfig
```kconfig
#
# sunxi system information driver.
#

config SUNXI_SYS_INFO
	tristate "sunxi system info driver"
	depends on ARCH_SUNXI
	depends on NVMEM_SUNXI_SID
	help
	  This driver is used for query system information.
	  If you don't know whether need it, please select y.
```

## drivers/misc/sunxi-addr/Kconfig
```kconfig
config SUNXI_ADDR_MGMT
	tristate "Allwinner Network MAC Addess Manager"
	depends on BT || ETHERNET || WLAN
	depends on NVMEM_SUNXI_SID
	select CRYPTO_LIB_SHA256
	help
	  Allwinner network MAC address management
```
